## user_battery/Kconfig
```kconfig
menu "battery Configuration"

    config BATTERY_ADC_CH
        int "channel of the adc"
        range 0 4 if IDF_TARGET_ESP32C3
		default 0 if IDF_TARGET_ESP32C3
		range 0 9 if IDF_TARGET_ESP32S3
        default 0 if IDF_TARGET_ESP32S3
        help
            esp32c3 ch0 - ch4 ~ gpio0 - gpio4
			esp32s3 ch0 - ch9 ~ gpio1 - gpio10
	
	config BATTERY_ADC_ATTEN
		int "atten(db) of the adc"
		default 3
		help
			0: ADC_ATTEN_DB_0		0 mV ~ 950 mV(esp32s3)	0 mV ~ 750 mV(esp32c3).
			1: ADC_ATTEN_DB_2_5		0 mV ~ 1250 mV(esp32s3)	0 mV ~ 1050 mV(esp32c3).
			2: ADC_ATTEN_DB_6		0 mV ~ 1750 mV(esp32s3)	0 mV ~ 1300 mV(esp32c3).
			3: ADC_ATTEN_DB_12		0 mV ~ 3100 mV(esp32s3)	0 mV ~ 2500 mV(esp32c3).
			ADC_ATTEN_DB_11 means the same as ADC_ATTEN_DB_12.

	config BATTERY_ADC_CALI_SCHEME
		int "calibration scheme"
		default 1 if IDF_TARGET_ESP32C3
		default 3 if IDF_TARGET_ESP32S3
		help
			constant value

	config BATTERY_ADC_VOLTAGE_DIV
		int "voltage division by resistance"
		default 2
		help
			real voltage = adc_voltage * div

	config BATTERY_VOLTAGE_MIN
		int "minimum voltage of the battery"
		default 3400
		help
			unit: mv

	config BATTERY_VOLTAGE_MAX
		int "maximum voltage of the battery"
		default 4100
		help
			unit: mv
endmenu
```

## user_es8311/Kconfig
```kconfig
menu "es8311 Configuration"

	config ES8311_I2C_PORT
		hex "I2C port of ES8311"
		default 0
		help
			0 / 1

	config ES8311_I2C_ADDR
		hex "I2C address of ES8311"
		default 0x18
		help
			ES8311 address: CE pin low - 0x18, CE pin high - 0x19

    config ES8311_I2C_MASTER_SCL
        int "SCL GPIO Number"
        default 5 if IDF_TARGET_ESP8266
        default 6 if IDF_TARGET_ESP32C3
        default 19 if IDF_TARGET_ESP32 || IDF_TARGET_ESP32S2 || IDF_TARGET_ESP32S3
        help
            GPIO number for I2C Master clock line.

    config ES8311_I2C_MASTER_SDA
        int "SDA GPIO Number"
        default 4 if IDF_TARGET_ESP8266
        default 5 if IDF_TARGET_ESP32C3
        default 18 if IDF_TARGET_ESP32 || IDF_TARGET_ESP32S2 || IDF_TARGET_ESP32S3
        help
            GPIO number for I2C Master data line.


	config ES8311_I2S_PORT
		hex "I2S port of ES8311"
		default 0
		help
			0 / 1

	config ES8311_I2S_MCK
		int "MCK GPIO Number"
		default 5
		help
			GPIO number for I2S MCK.

	config ES8311_I2S_BCK
		int "BCK GPIO Number"
		default 16
		help
			GPIO number for I2S BCK.

	config ES8311_I2S_WS
		int "WS GPIO Number"
		default 7
		help
			GPIO number for I2S WS.

	config ES8311_I2S_DO
		int "DO GPIO Number"
		default 6
		help
			GPIO number for I2S DO.

	config ES8311_I2S_DI
		int "DI GPIO Number"
		default -1
		help
			GPIO number for I2S DI.



    choice ES8311_SELECT_MIC_GAIN
        prompt "Set MIC gain"
        depends on EXAMPLE_MODE_ECHO
        default MIC_GAIN_18DB
        help
            Select mic gain for echo mode

        config MIC_GAIN_0DB
            bool "0dB"
        config MIC_GAIN_6DB
            bool "6dB"
        config MIC_GAIN_12DB
            bool "12dB"
        config MIC_GAIN_18DB
            bool "18dB"
        config MIC_GAIN_24DB
            bool "24dB"
        config MIC_GAIN_30DB
            bool "30dB"
        config MIC_GAIN_36DB
            bool "36dB"
        config MIC_GAIN_42DB
            bool "42dB"
    endchoice

    config ES8311_MIC_GAIN
        int
        default 0 if MIC_GAIN_0DB
        default 1 if MIC_GAIN_6DB
        default 2 if MIC_GAIN_12DB
        default 3 if MIC_GAIN_18DB
        default 4 if MIC_GAIN_24DB
        default 5 if MIC_GAIN_30DB
        default 6 if MIC_GAIN_36DB
        default 7 if MIC_GAIN_42DB

    config ES8311_VOICE_VOLUME
        int "Voice volume"
        range 0 100
        default 60
        help
            Set voice volume

endmenu
```

## user_hp303s/Kconfig
```kconfig
menu "hp303s config"
	config 74HC138_A0_GPIO
        int "74HC138 A0 GPIO number"
        default 10
        help
            GPIO number connected to A0 pin

	config 74HC138_A1_GPIO
		int "74HC138 A1 GPIO number"
		default 9
		help
			GPIO number connected to A1 pin

	config 74HC138_A2_GPIO
		int "74HC138 A2 GPIO number"
		default 14
		help
			GPIO number connected to A2 pin

	config HP303S_MOSI_GPIO
		int "HP303S MOSI GPIO number"
		default 11
		help
			GPIO number connected to HP303S MISO pin

	config HP303S_MISO_GPIO
		int "HP303S MISO GPIO number"
		default 13
		help
			GPIO number connected to HP303S MOSI pin

	config HP303S_CLK_GPIO
		int "HP303S CLK GPIO number"
		default 12
		help
			GPIO number connected to HP303S CLK pin

	
endmenu
```

## user_hx710a/Kconfig
```kconfig
menu "hx710a configuration"

    config HX710A_PD_SCK_GPIO
        int "PD/SCK GPIO number"
        default 4 if IDF_TARGET_ESP8266 || IDF_TARGET_ESP32C3
        default 1 if IDF_TARGET_ESP32 || IDF_TARGET_ESP32S2 || IDF_TARGET_ESP32S3
        help
            GPIO number connected to PD/SCK pin

    config HX710A_DOUT_GPIO
        int "DOUT GPIO number"
        default 5 if IDF_TARGET_ESP8266 || IDF_TARGET_ESP32C3
        default 2 if IDF_TARGET_ESP32 || IDF_TARGET_ESP32S2 || IDF_TARGET_ESP32S3
        help
            GPIO number connected to DOUT pin

    config HX710A_AVG_TIMES
        int "Samples to average"
        default 5

	config HX710A_RES
		int "raw / kg"
		default 6710
		#default 167772
endmenu
```

## user_tca95x5/Kconfig
```kconfig
menu "tca95x5 configuration"

	config TCA95X5_I2C_PORT
		hex "I2C port of TCA9555"
		default 0
		help
			0 / 1	

	config TCA95X5_I2C_ADDR
		hex "I2C address of TCA9555"
		default 0x20
		help
			I2C address of TCA9555. The default is `TCA95X5_I2C_ADDR_BASE`, or
			0x20. See available options in datasheet.
			0x20 - A2 A1 A0 000
			0X24 - A2 A1 A0 100

    config TCA95X5_I2C_MASTER_SCL
        int "SCL GPIO Number"
        default 5 if IDF_TARGET_ESP8266
        default 6 if IDF_TARGET_ESP32C3
        default 19 if IDF_TARGET_ESP32 || IDF_TARGET_ESP32S2 || IDF_TARGET_ESP32S3
        help
            GPIO number for I2C Master clock line.

    config TCA95X5_I2C_MASTER_SDA
        int "SDA GPIO Number"
        default 4 if IDF_TARGET_ESP8266
        default 5 if IDF_TARGET_ESP32C3
        default 18 if IDF_TARGET_ESP32 || IDF_TARGET_ESP32S2 || IDF_TARGET_ESP32S3
        help
            GPIO number for I2C Master data line.

endmenu
```

## user_udp_multicast/Kconfig
```kconfig
menu "UDP multicast Configuration"

    choice UDP_MULTICAST_IP_MODE
        prompt "Multicast IP type"
        help
            Example can multicast IPV4, IPV6, or both.

        config UDP_MULTICAST_IPV4_V6
            bool "IPV4 & IPV6"
            select UDP_MULTICAST_IPV4
            select UDP_MULTICAST_IPV6

        config UDP_MULTICAST_IPV4_ONLY
            bool "IPV4"
            select UDP_MULTICAST_IPV4

        config UDP_MULTICAST_IPV6_ONLY
            bool "IPV6"
            select UDP_MULTICAST_IPV6

    endchoice

    config UDP_MULTICAST_IPV4
        bool
    config UDP_MULTICAST_IPV6
        bool
        select UDP_MULTICAST_CONNECT_IPV6 if IDF_TARGET_ESP32

    config UDP_MULTICAST_IPV4_ADDR
        string "Multicast IPV4 Address (send & receive)"
        default "232.10.11.12"
        depends on UDP_MULTICAST_IPV4
        help
            IPV4 multicast address. Example will both send to and listen to this address.

    config UDP_MULTICAST_IPV6_ADDR
        string "Multicast IPV6 Address (send & receive)"
        default "FF02::FC"
        depends on UDP_MULTICAST_IPV6
        help
            IPV6 multicast address. Example will both send to and listen to this address.

            The default FF02::FC address is a link-local multicast address.
            Consult IPV6 specifications or documentation for information about
            meaning of different IPV6 multicast ranges.

    config UDP_MULTICAST_PORT
        int "Multicast port (send & receive)"
        range 0 65535
        default 3333
        help
            Multicast port the example will both send & receive UDP packets on.

    config UDP_MULTICAST_LOOPBACK
        bool "Multicast loopback"
        help
            Enables IP_MULTICAST_LOOP/IPV6_MULTICAST_LOOP options, meaning
            that packets transmitted from the device are also received by the
            device itself.

    config UDP_MULTICAST_TTL
        int  "Multicast packet TTL"
        range 1 255
        help
            Sets TTL field of multicast packets. Separate from uni- & broadcast TTL.

    choice UDP_MULTICAST_IF
        prompt "Multicast Interface"
        default UDP_MULTICAST_LISTEN_DEFAULT_IF
        help
            Multicast socket can bind to default interface, or all interfaces.

        config UDP_MULTICAST_LISTEN_ALL_IF
            bool "All interfaces (IPV4 only)"
            depends on !UDP_MULTICAST_IPV6_ONLY

        config UDP_MULTICAST_LISTEN_DEFAULT_IF
            bool "Default interface"

    endchoice

endmenu
```
